## boards/shields/MonoCirque/Kconfig.defconfig
```kconfig
# Copyright (c) 2022 The ZMK Contributors
# SPDX-License-Identifier: MIT

if SHIELD_MONOCIRQUE

config ZMK_KEYBOARD_NAME
    default "MonoCirque"

config ZMK_STUDIO
  default y

endif
```

## boards/shields/MonoCirque/Kconfig.shield
```kconfig
# Copyright (c) 2022 The ZMK Contributors
# SPDX-License-Identifier: MIT

config SHIELD_MONOCIRQUE
   def_bool $(shields_list_contains,monocirque)
```

## config/west.yml
```yaml
manifest:
  defaults:
    revision: v0.3
  remotes:
    - name: zmkfirmware
      url-base: https://github.com/zmkfirmware
    - name: petejohanson  # ADD THIS
      url-base: https://github.com/petejohanson
    # Add this:
    - name: halfdane
      url-base: https://github.com/halfdane/
  projects:
    - name: zmk
      remote: zmkfirmware
      import: app/west.yml
    # Add this:
    - name: zmk-input-gestures
      remote: halfdane
      revision: main
    # Add these if you want to use absolute mode:
    - name: zmk-input-processors
      remote: halfdane
      revision: main
    - name: cirque-input-module
      remote: halfdane
      revision: absolute_mode
  self:
    path: config
```
